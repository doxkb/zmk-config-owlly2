## boards/shields/owlly/Kconfig.defconfig
```kconfig
# Copyright (c) 2020 The ZMK Contributors
# SPDX-License-Identifier: MIT

if SHIELD_OWLLY_LEFT

config ZMK_KEYBOARD_NAME
	default "Owlly"

config ZMK_SPLIT_BLE_ROLE_CENTRAL
	default y

endif

if SHIELD_OWLLY_LEFT || SHIELD_OWLLY_RIGHT

config ZMK_SPLIT
	default y

endif
```

## boards/shields/owlly/Kconfig.shield
```kconfig
# Copyright (c) 2020 The ZMK Contributors
# SPDX-License-Identifier: MIT

config SHIELD_OWLLY_LEFT
	def_bool $(shields_list_contains,owlly_left)

config SHIELD_OWLLY_RIGHT
	def_bool $(shields_list_contains,owlly_right)
```

## boards/shields/owlly2/Kconfig.defconfig
```kconfig
# Copyright (c) 2020 The ZMK Contributors
# SPDX-License-Identifier: MIT

if SHIELD_OWLLY2_LEFT

config ZMK_KEYBOARD_NAME
	default "Owlly2"

config ZMK_SPLIT_BLE_ROLE_CENTRAL
	default y

endif

if SHIELD_OWLLY2_LEFT || SHIELD_OWLLY2_RIGHT

config ZMK_SPLIT
	default y

endif
```

## boards/shields/owlly2/Kconfig.shield
```kconfig
# Copyright (c) 2020 The ZMK Contributors
# SPDX-License-Identifier: MIT

config SHIELD_OWLLY2_LEFT
	def_bool $(shields_list_contains,owlly2_left)

config SHIELD_OWLLY2_RIGHT
	def_bool $(shields_list_contains,owlly2_right)
```
